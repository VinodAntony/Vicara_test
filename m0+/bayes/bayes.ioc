# file: bayes.ioc
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Mcu.Family=STM32G0
RCC.VCOOutputFreq_Value=128000000
RCC.CortexFreq_Value=8000000
RCC.ADCFreq_Value=64000000
VP_SYS_VS_DBSignals.Mode=DisableDeadBatterySignals
RCC.AHBCLKDivider=RCC_SYSCLK_DIV8
VP_TIM6_VS_ClockSourceINT.Mode=Enable_Timer
RCC.EXTERNAL_CLOCK_VALUE=48000
Mcu.Name=STM32G070CBTx
RCC.APB1CLKDivider=RCC_HCLK_DIV16
RCC.SYSCLKFreq_VALUE=64000000
Mcu.Package=LQFP48
RCC.SYSCLKSource=RCC_SYSCLKSOURCE_PLLCLK
ProjectManager.StackSize=0x400
TIM6.AutoReloadPreload=TIM_AUTORELOAD_PRELOAD_DISABLE
ProjectManager.HeapSize=0x200
ProjectManager.TargetToolchain=MDK-ARM V5.27
RCC.HSI_VALUE=16000000
RCC.HCLKFreq_Value=8000000
RCC.LSE_VALUE=32768
RCC.AHBFreq_Value=8000000
RCC.HSE_VALUE=8000000
board=custom

// file: Core/Src/main.c
/* USER CODE BEGIN Header */
/**
  ******************************************************************************
  * @file           : main.c
  * @brief          : Main program body
  ******************************************************************************
  * @attention
  *
  * <h2><center>&copy; Copyright (c) 2021 STMicroelectronics.
  * All rights reserved.</center></h2>
  *
  * This software component is licensed by ST under BSD 3-Clause license,
  * the "License"; You may not use this file except in compliance with the
  * License. You may obtain a copy of the License at:
  *                        opensource.org/licenses/BSD-3-Clause
  *
  ******************************************************************************
  */
/* USER CODE END Header */
#include "main.h"

#include <math.h>
#include <stdio.h>
#include "arm_math.h"

TIM_HandleTypeDef htim6;
arm_gaussian_naive_bayes_instance_f32 S;

#define NUM_OF_CLASSES 3
#define VEC_DIM 2

void SystemClock_Config(void);
static void MX_TIM6_Init(void);

/* USER CODE BEGIN 0 */
/* the following values were taken from  Vicara_test/dataset-trainer/output.txt */
const float32_t theta[NUM_OF_CLASSES*VEC_DIM] = {
1.387475824161616f, 0.8800443869905078f, -1.6720396473828638f,
0.9348414373983904f, -0.07495431391816572f, -2.899784943630995f}; /**< Mean values for the Gaussians */

const float32_t sigma[NUM_OF_CLASSES*VEC_DIM] = {
0.980470340849684f, 1.18166934802584f, 1.0641256105658998f,
1.0040083397932336f, 0.917027316127453f, 0.9105702307997193f}; /**< Variances for the Gaussians */

const float32_t classPriors[NUM_OF_CLASSES] = {
  0.3333333333333333f, 0.3333333333333333f, 0.3333333333333333f
}; /*< Class prior probabilities */

void delay_ms(){
		TIM6->ARR = 1000;
		TIM6->CR1 |= TIM_CR1_CEN;
		int i=10;
		while(i--)
			while(TIM6->CNT != 1000); // time for counter to reach 1000 = 1ms , repeated 10 times = 10ms
}

/* USER CODE END 0 */

int main(void)
{
  /* USER CODE BEGIN 1 */
/* input with 2 dimensions*/
  float32_t in[2];

  /* Result of the classifier */
  float32_t result[NUM_OF_CLASSES];
  uint32_t index;

  S.vectorDimension = VEC_DIM;
  S.numberOfClasses = NUM_OF_CLASSES;
  S.theta = theta; /* mean values */
  S.sigma = sigma; /* variance */
  S.classPriors = classPriors; /* probability of occurence of each class 1/3,1/3,1/3 in this case */
  S.epsilon= 4.253690631668857e-09f;

  /* USER CODE END 1 */

  /* MCU Configuration--------------------------------------------------------*/

  /* Reset of all peripherals, Initializes the Flash interface and the Systick. */
  HAL_Init();

  /* Configure the system clock */
  SystemClock_Config();

  /* Initialize all configured peripherals */
  MX_TIM6_Init();

  /* Infinite loop */
  while (1)
  {
	/*test values for class 0 */
  in[0] = 1.5f;
  in[1] = 1.0f;
	/*test values for class 1 */
	//in[0] = -1.5f;
  //in[1] = 1.0f;
	/*test values for class 2 */
	//in[0] = 0.0f;
  //in[1] = -3.0f;
		//printf("hi\n\n");
		//scanf("%f%f",&in[0],&in[1]);
		//scanf("%f ",&in[1]);
		index = arm_gaussian_naive_bayes_predict_f32(&S, in, result);
		printf("Class = %d\n\n", index);
		delay_ms();
  }
}

void SystemClock_Config(void)
{
  RCC_OscInitTypeDef RCC_OscInitStruct = {0};
  RCC_ClkInitTypeDef RCC_ClkInitStruct = {0};

  /** Configure the main internal regulator output voltage
  */
  HAL_PWREx_ControlVoltageScaling(PWR_REGULATOR_VOLTAGE_SCALE1);
  /** Initializes the RCC Oscillators according to the specified parameters
  * in the RCC_OscInitTypeDef structure.
  */
  RCC_OscInitStruct.OscillatorType = RCC_OSCILLATORTYPE_HSI;
  RCC_OscInitStruct.HSIState = RCC_HSI_ON;
  RCC_OscInitStruct.HSIDiv = RCC_HSI_DIV1;
  RCC_OscInitStruct.HSICalibrationValue = RCC_HSICALIBRATION_DEFAULT;
  RCC_OscInitStruct.PLL.PLLState = RCC_PLL_ON;
  RCC_OscInitStruct.PLL.PLLSource = RCC_PLLSOURCE_HSI;
  RCC_OscInitStruct.PLL.PLLM = RCC_PLLM_DIV1;
  RCC_OscInitStruct.PLL.PLLN = 8;
  RCC_OscInitStruct.PLL.PLLP = RCC_PLLP_DIV2;
  RCC_OscInitStruct.PLL.PLLR = RCC_PLLR_DIV2;
  if (HAL_RCC_OscConfig(&RCC_OscInitStruct) != HAL_OK)
  {
    Error_Handler();
  }
  /** Initializes the CPU, AHB and APB buses clocks
  */
  RCC_ClkInitStruct.ClockType = RCC_CLOCKTYPE_HCLK|RCC_CLOCKTYPE_SYSCLK
                              |RCC_CLOCKTYPE_PCLK1;
  RCC_ClkInitStruct.SYSCLKSource = RCC_SYSCLKSOURCE_PLLCLK;
  RCC_ClkInitStruct.AHBCLKDivider = RCC_SYSCLK_DIV8;
  RCC_ClkInitStruct.APB1CLKDivider = RCC_HCLK_DIV16;

  if (HAL_RCC_ClockConfig(&RCC_ClkInitStruct, FLASH_LATENCY_0) != HAL_OK)
  {
    Error_Handler();
  }
}

static void MX_TIM6_Init(void)
{

  TIM_MasterConfigTypeDef sMasterConfig = {0};

  htim6.Instance = TIM6;
  htim6.Init.Prescaler = 0;
  htim6.Init.CounterMode = TIM_COUNTERMODE_UP;
  htim6.Init.Period = 65535;
  htim6.Init.AutoReloadPreload = TIM_AUTORELOAD_PRELOAD_DISABLE;
  if (HAL_TIM_Base_Init(&htim6) != HAL_OK)
  {
    Error_Handler();
  }
  sMasterConfig.MasterOutputTrigger = TIM_TRGO_RESET;
  sMasterConfig.MasterSlaveMode = TIM_MASTERSLAVEMODE_DISABLE;
  if (HAL_TIMEx_MasterConfigSynchronization(&htim6, &sMasterConfig) != HAL_OK)
  {
    Error_Handler();
  }

}

void Error_Handler(void)
{
  __disable_irq();
  while (1)
  {
  }
}

/************************ (C) COPYRIGHT STMicroelectronics *****END OF FILE****/
